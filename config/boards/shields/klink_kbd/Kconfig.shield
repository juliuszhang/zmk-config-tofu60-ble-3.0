## config/boards/shields/klink_kbd/Kconfig.shield
```kconfig
# Copyright (c) 2020 The ZMK Contributors
# SPDX-License-Identifier: MIT

config SHIELD_TOFU60_BLE_V3_HHKB
    def_bool $(shields_list_contains,tofu60_ble_v3_hhkb)
    select SPI
```

## config/boards/shields/klink_kbd/boards/klink.conf
```kconfig
# All config for this keyboard
CONFIG_BUILD_OUTPUT_UF2_FAMILY_ID="0x59952840"

CONFIG_SPI=y

#USB
CONFIG_ZMK_USB=y
CONFIG_USB_DEVICE_VID=0x9D5B
CONFIG_USB_DEVICE_PID=0x2562
CONFIG_USB_DEVICE_MANUFACTURER="KBDFans"
CONFIG_ZMK_KEYBOARD_NAME="Tofu60 BLE 3.0(USB)"

#BLE
CONFIG_ZMK_BLE=y
CONFIG_BT_DEVICE_NAME_MAX=23
CONFIG_BT_DEVICE_NAME="Tofu60 BLE 3.0"
CONFIG_ZMK_BLE_EXPERIMENTAL_CONN=y
CONFIG_BT_CTLR_TX_PWR_PLUS_8=y
CONFIG_ZMK_IDLE_TIMEOUT=30000
#CONFIG_ZMK_SLEEP=y
#CONFIG_ZMK_IDLE_SLEEP_TIMEOUT=12000000

#
CONFIG_ZMK_HID_CONSUMER_REPORT_USAGES_FULL=y
CONFIG_ZMK_HID_INDICATORS=y

CONFIG_ZMK_KSCAN_DEBOUNCE_PRESS_MS=3
CONFIG_ZMK_KSCAN_DEBOUNCE_RELEASE_MS=5

# No RGB.
CONFIG_ZMK_EXT_POWER=n
```

## config/west.yml
```yaml
manifest:
  remotes:
    - name: zmkfirmware
      url-base: https://github.com/zmkfirmware
    - name: yangdigi
      url-base: https://github.com/yangdigi
    # Additional modules containing boards/shields/custom code can be listed here as well
    # See https://docs.zephyrproject.org/3.2.0/develop/west/manifest.html#projects
  projects:
    - name: zmk
      remote: yangdigi
      revision: c526c062f974c87172782b8d964e2dd918e81923
      import: app/west.yml
    - name: zmk-keyboards-klink
      remote: yangdigi
      revision: e80a8335563aec32a8f2c47cba697077291bfb99
  self:
    path: config
```

## dts/bindings/behaviors/klink,behavior-indicator-refresh.yaml
```yaml
# Copyright (c) 2026
# SPDX-License-Identifier: MIT

description: Refresh the Klink keyboard status indicator
compatible: "klink,behavior-indicator-refresh"
include: zero_param.yaml
```
